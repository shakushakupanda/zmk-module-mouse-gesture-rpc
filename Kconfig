## Kconfig
```kconfig
config ZMK_MOUSE_GESTURE_RPC
    bool "Enable runtime-configurable mouse gesture (via custom Studio RPC)"
    depends on ZMK_STUDIO
    select SETTINGS
    select NVS
    select FLASH
    select FLASH_MAP
    help
      Provides a Custom Studio RPC subsystem (identifier: "cormoran_mg")
      that lets DYA Studio enumerate, add, edit, and delete mouse-gesture
      patterns and tweak runtime parameters (stroke size, idle timeout,
      cooldown, etc.) without rebuilding firmware.

      The static kot149/zmk-mouse-gesture devicetree configuration is still
      used as the initial default set of gestures. Changes made via Studio
      are stored in non-volatile settings and persist across reboots.

if ZMK_MOUSE_GESTURE_RPC

config ZMK_MOUSE_GESTURE_RPC_LOG_LEVEL
    int "Log level for the mouse-gesture RPC handler"
    default 2
    range 0 4
    help
      0=off, 1=err, 2=warn, 3=info, 4=dbg

config ZMK_MOUSE_GESTURE_RPC_MAX_GESTURES
    int "Maximum number of stored gestures"
    default 12
    range 1 12
    help
      Hard upper bound on how many gestures the runtime store can hold.
      Default is 12 = 3 sets x 4 one-direction gesture cells.
      Must not exceed the value declared for ListGesturesResponse.gestures
      in proto/zmk/mouse_gesture/custom.options.

config ZMK_MOUSE_GESTURE_RPC_NUM_SETS
    int "Number of gesture sets (multi-set Approach D)"
    default 3
    range 1 3
    help
      How many independent gesture sets the firmware exposes. Each set
      is addressable by `&mg_set N` (N in 0..NUM_SETS-1). Sets share the
      single mg input-processor instance: pressing `&mg_set N` switches
      the active set and starts gesture matching with that set's
      patterns. Suggested/default: 3 (= 3 activation keys × 4 directions).

endif
```

## dts/bindings/behaviors/zmk,behavior-mg-set-fixed.yaml
```yaml
# Copyright (c) 2026 shakushakupanda
# SPDX-License-Identifier: MIT

description: Fixed mouse gesture key behavior for DYA/ZMK Studio
compatible: "zmk,behavior-mg-set-fixed"

include: zero_param.yaml
```

## dts/bindings/behaviors/zmk,behavior-mg-set.yaml
```yaml
# Copyright (c) 2026 shakushakupanda
# SPDX-License-Identifier: MIT
#
# Generic one-param mouse-gesture set activation behavior.
# Use &mg_set N in hand-written keymaps.

description: Mouse gesture set activation behavior
compatible: "zmk,behavior-mg-set"

include: one_param.yaml
```
