## dts/bindings/input_processors/zmk,input-processor-inertial-scroll.yaml
```yaml
# Copyright (c) 2026
# SPDX-License-Identifier: MIT

description: |
  Smooth raw wheel movement and add flick-only inertia. Add a zmk,input-listener
  whose device and input-processors both reference this processor node so timed
  output runs on the input thread. input-divisor replaces upstream wheel scaling.

compatible: "zmk,input-processor-inertial-scroll"

properties:
  input-divisor:
    type: int
    default: 1
    description: Raw wheel counts per ordinary wheel step, before smoothing.
  scroll-layers:
    type: array
    description: Layers that permit queued scroll output. Leaving all of them cancels motion.
  "#input-processor-cells":
    type: int
    required: true
    const: 0
  track-remainders:
    type: boolean
  enabled:
    type: boolean
    description: Enable inertial scroll by default.
  codes:
    type: array
    description: Deprecated/ignored. Inertial scroll currently applies to WHEEL and HWHEEL.
  tick-ms:
    type: int
    default: 20
    description: Period between inertial scroll ticks in milliseconds.
  idle-ms:
    type: int
    default: 24
    description: Delay after the last real scroll event before inertia starts.
  decay-percent:
    type: int
    default: 86
    description: Velocity multiplier applied every tick, in percent.
  impulse-percent:
    type: int
    default: 180
    description: How much of the last real scroll value becomes inertial velocity.
  min-velocity-q8:
    type: int
    default: 96
    description: Stop when absolute fixed-point velocity falls below this threshold.
  max-ticks:
    type: int
    default: 36
    description: Safety cap for one inertial run.
```
